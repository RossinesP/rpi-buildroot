## package/python-rpigpio/Config.in
```kconfig
config BR2_PACKAGE_PYTHON_RPIGPIO
	bool "python-rpigpio"
	depends on BR2_PACKAGE_PYTHON3
	help
	python-rpigpio is a Python library to access rpi's gpio
```
